## drivers/bluetooth/hci/Kconfig.stm32
```kconfig
# Copyright (c) 2025 STMicroelectronics
#
# SPDX-License-Identifier: Apache-2.0

menu "STM32WBA Bluetooth configuration"
	depends on BT_STM32WBA

config BT_STM32WBA_USE_TEMP_BASED_CALIB
	bool "STM32WBA Radio calibration based on temperature sensor"
	default y
	select SENSOR
	select STM32_TEMP
	help
	  Allows the linklayer to calibrate itself on the current temperature read on the ADC4

config BT_STM32WBA_LIB_CONFIG
	string "STM32WBA Bluetooth library configuration"
	default 'full' if BT_EXT_ADV || BT_PER_ADV || BT_PER_ADV_SYNC || BT_SCA_UPDATE \
		     || (BT_DF_CTE_RX_AOA || BT_CTLR_DF_ANT_SWITCH_RX || BT_CTLR_DF_ANT_SWITCH_TX || BT_DF_CTE_TX_AOD) \
		     || (BT_PER_ADV_SYNC_TRANSFER_RECEIVER || BT_PER_ADV_SYNC_TRANSFER_SENDER || BT_CTLR_SYNC_PERIODIC) \
		     || BT_ISO_UNICAST || BT_ISO_BROADCASTER || BT_ISO_SYNC_RECEIVER || BT_TRANSMIT_POWER_CONTROL \
		     || BT_SUBRATING || BT_CTLR_ADV_PERIODIC_ADI_SUPPORT || BT_EXT_ADV_CODING_SELECTION
	default 'basic'
	help
	  sets the library configuration according to Bluetooth features

endmenu
```

## dts/bindings/crypto/st,stm32-aes.yaml
```yaml
# Copyright (c) 2021, Thomas Stranger
# SPDX-License-Identifier: Apache-2.0

description: STM32 AES Accelerator

compatible: "st,stm32-aes"

include: st,stm32-crypto-common.yaml

properties:
  gcm-ccm-supported:
    type: boolean
    description: Enables AES GCM and CCM support.
```

## soc/st/stm32/stm32wbax/Kconfig
```kconfig
# ST Microelectronics STM32WBA MCU series

# Copyright (c) 2023 STMicroelectronics
# SPDX-License-Identifier: Apache-2.0

config SOC_SERIES_STM32WBAX
	select ARM
	select CPU_CORTEX_M33
	select ARM_TRUSTZONE_M
	select CPU_HAS_ARM_SAU
	select CPU_HAS_ARM_MPU
	select CPU_HAS_FPU
	select ARMV8_M_DSP
	select CPU_CORTEX_M_HAS_DWT
	select HAS_STM32CUBE
	select HAS_STM32_FLASH_PREFETCH
	select USE_STM32_HAL_PWR_EX
	select USE_STM32_HAL_CORTEX
	select HAS_PM
	select HAS_POWEROFF
	select SOC_EARLY_INIT_HOOK
	select PM_DEVICE if PM
	select PM_DEVICE_RUNTIME if PM
	select PM_DEVICE_SYSTEM_MANAGED if PM

if SOC_SERIES_STM32WBAX

config STM32WBA_LL_THREAD_STACK_SIZE
	int "Stack size of the Link Layer thread"
	default 1536
	depends on BT_STM32WBA || IEEE802154_STM32WBA
	help
	  Linl Layer thread stack size in bytes.

config STM32WBA_LL_THREAD_PRIORITY
	int "Link Layer thread priority"
	default 4
	depends on BT_STM32WBA || IEEE802154_STM32WBA
	help
	  This options sets the priority of the Link Layer thread.
	  The LL thread shall have an higher priority than the 
	  BLE CTRL thread and the Zephyr stack threads.

config STM32WBA_BLE_CTRL_THREAD_STACK_SIZE
	int "Stack size of the BLE Controller thread"
	default 512
	depends on BT_STM32WBA
	help
	  BLE Controller thread stack size in bytes.

config STM32WBA_BLE_CTRL_THREAD_PRIORITY
	int "BLE Controller thread priority"
	depends on BT_STM32WBA
	default 14
	help
	  This options sets the priority of the BLE Controller thread.

endif # SOC_SERIES_STM32WBAX
```
